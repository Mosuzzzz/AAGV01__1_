// ============================================================

// LINE FOLLOWING ROBOT - ESP32

// ============================================================

//

// SENSOR

// U2 = ซ้าย  -> GPIO35

// U4 = กลาง  -> GPIO16

// U5 = ขวา   -> GPIO17

//

// Sensor:

// ดำ  = 0

// ขาว = 1

//

// MOTOR ขวา

// ENA = GPIO23

// IN1 = GPIO25

// IN2 = GPIO26

//

// MOTOR ซ้าย

// ENB = GPIO18

// IN3 = GPIO32

// IN4 = GPIO33

//

// ตอนนี้:

// - ยังไม่ชดเชยความเร็วซ้าย/ขวา

// - วิ่งช้า

// - มีระบบค้นหาเส้นเมื่อหลุดเส้น

// ============================================================

// ============================================================

// 1. SENSOR

// ============================================================

const int SENSOR_LEFT   = 35;   // U2

const int SENSOR_CENTER = 16;   // U4

const int SENSOR_RIGHT  = 17;   // U5

// ============================================================

// 2. MOTOR

// ============================================================

// มอเตอร์ขวา

const int ENA = 23;

const int IN1 = 25;

const int IN2 = 26;

// มอเตอร์ซ้าย

const int ENB = 18;

const int IN3 = 32;

const int IN4 = 33;

// ============================================================

// 3. SPEED

// ============================================================

// ความเร็วเดินตรง

// เริ่มต้นช้า ๆ ก่อน

const int BASE_SPEED = 25;

// ความเร็วตอนเลี้ยว

const int TURN_SPEED = 15;

// ============================================================

// 4. จำตำแหน่งเส้นล่าสุด

//

// -1 = เส้นล่าสุดอยู่ทางซ้าย

//  0 = เส้นล่าสุดอยู่ตรงกลาง

//  1 = เส้นล่าสุดอยู่ทางขวา

//

// ใช้เฉพาะตอน 3 sensor เป็น 111

// ============================================================

int lastDirection = 0;

// ============================================================

// 5. SETUP

// ============================================================

void setup() {

  // Sensor

  pinMode(SENSOR_LEFT, INPUT);

  pinMode(SENSOR_CENTER, INPUT);

  pinMode(SENSOR_RIGHT, INPUT);

  // Motor ขวา

  pinMode(ENA, OUTPUT);

  pinMode(IN1, OUTPUT);

  pinMode(IN2, OUTPUT);

  // Motor ซ้าย

  pinMode(ENB, OUTPUT);

  pinMode(IN3, OUTPUT);

  pinMode(IN4, OUTPUT);

  // Serial Monitor

  Serial.begin(115200);

  // เริ่มต้นให้หุ่นหยุด

  stopMotor();

  delay(1000);

}

// ============================================================

// 6. LOOP

// ==========================
void loop() {

  // ----------------------------------------------------------

  // อ่าน sensor

  // ----------------------------------------------------------

  int left   = digitalRead(SENSOR_LEFT);

  int center = digitalRead(SENSOR_CENTER);

  int right  = digitalRead(SENSOR_RIGHT);

  // ----------------------------------------------------------

  // แสดงค่า sensor

  // ตัวอย่าง 101 = ขาว ดำ ขาว

  // ----------------------------------------------------------

  Serial.print("U2=");

  Serial.print(left);

  Serial.print("  U4=");

  Serial.print(center);

  Serial.print("  U5=");

  Serial.print(right);

  // ==========================================================

  // 101

  //

  // ซ้ายขาว / กลางดำ / ขวาขาว

  //

  // เส้นอยู่ตรงกลาง

  // ==========================================================

  if (left == 1 && center == 0 && right == 1) {

    Serial.println(" -> STRAIGHT");

    lastDirection = 0;

    forward(BASE_SPEED);

  }

  // ==========================================================

  // 011

  //

  // ซ้ายดำ / กลางขาว / ขวาขาว

  //

  // เส้นอยู่ทางซ้าย

  // ==========================================================

  else if (left == 0 && center == 1 && right == 1) {

    Serial.println(" -> LEFT");

    lastDirection = -1;

    turnLeft();

  }

  // ==========================================================

  // 001

  //

  // ซ้ายดำ / กลางดำ / ขวาขาว

  //

  // เส้นกินเข้ามาทางซ้าย

  // ==========================================================

  else if (left == 0 && center == 0 && right == 1) {

    Serial.println(" -> LEFT");

    lastDirection = -1;

    turnLeft();

  }

  // ==========================================================

  // 110

  //

  // ซ้ายขาว / กลางขาว / ขวาดำ

  //

  // เส้นอยู่ทางขวา

  // ==========================================================

  else if (left == 1 && center == 1 && right == 0) {

    Serial.println(" -> RIGHT");

    lastDirection = 1;

    turnRight();

  }

  // ==========================================================

  // 100

  //

  // ซ้ายขาว / กลางดำ / ขวาดำ

  //

  // เส้นกินเข้ามาทางขวา

  // ======================
else if (left == 1 && center == 0 && right == 0) {

    Serial.println(" -> RIGHT");

    lastDirection = 1;

    turnRight();

  }

  // ==========================================================

  // 000

  //

  // ทั้ง 3 ตัวเห็นดำ

  //

  // ค่าจาก sensor เหมือนกันทั้ง 3 ตัว

  // ให้หยุดเพื่อป้องกันรถวิ่งออกนอกเส้น

  // ==========================================================

  else if (left == 0 && center == 0 && right == 0) {

    Serial.println(" -> ALL BLACK / STOP");

    stopMotor();

  }
  // ==========================================================

  // 111

  //

  // ทั้ง 3 ตัวเห็นขาว

  //

  // = หาเส้นไม่เจอ

  //

  // ให้หยุดมอเตอร์ทันที

  // ==========================================================

  else if (left == 1 && center == 1 && right == 1) {

    Serial.println(" -> LINE LOST / STOP");

    stopMotor();

  }

  // ==========================================================

  // กรณีที่ไม่ตรงกับ pattern ที่กำหนด

  // ===========================
  else {

    Serial.println(" -> UNKNOWN");

    stopMotor();

  }

  // อ่าน sensor ใหม่ทุก 10 ms

  delay(10);

}

// ============================================================

// 7. เดินหน้า

// ============================================================

void forward(int speedValue) {

  // มอเตอร์ขวาเดินหน้า

  digitalWrite(IN1, HIGH);

  digitalWrite(IN2, LOW);

  // มอเตอร์ซ้ายเดินหน้า

  digitalWrite(IN3, LOW);

  digitalWrite(IN4, HIGH);

  // ตอนนี้ยังใช้ความเร็วเท่ากัน

  analogWrite(ENA, speedValue);

  analogWrite(ENB, speedValue);

}

// ============================================================

// 8. เลี้ยวซ้าย

// ============================================================

//

// ล้อขวา = ทำงาน

// ล้อซ้าย = หยุด

//

// หุ่นจึงหันไปทางซ้าย

// ============================================================

void turnLeft() {

  // มอเตอร์ขวาเดินหน้า

  digitalWrite(IN1, HIGH);

  digitalWrite(IN2, LOW);

  // หยุดมอเตอร์ซ้าย

  digitalWrite(IN3, LOW);

  digitalWrite(IN4, LOW);

  analogWrite(ENA, BASE_SPEED);

  analogWrite(ENB, 0);

  delay(500);

}

// ============================================================

// 9. เลี้ยวขวา

// ============================================================

//

// ล้อซ้าย = ทำงาน

// ล้อขวา = หยุด

//

// หุ่นจึงหันไปทางขวา

// ============================================================

void turnRight() {

  // หยุดมอเตอร์ขวา

  digitalWrite(IN1, LOW);

  digitalWrite(IN2, LOW);

  // มอเตอร์ซ้ายเดินหน้า

  digitalWrite(IN3, LOW);

  digitalWrite(IN4, HIGH);

  analogWrite(ENA, 0);

  analogWrite(ENB, BASE_SPEED);

  delay(500);

}

// ============================================================

// 10. ค้นหาเส้นทางซ้าย

// ============================================================

//

// เมื่อหลุดเส้นและเส้นล่าสุดอยู่ทางซ้าย

//

// หยุดล้อซ้าย

// ปล่อยล้อขวาเดินหน้า

//

// หุ่นจะค่อย ๆ หันไปทางซ้าย

// ============================================================

void searchLeft() {

  // มอเตอร์ขวาเดินหน้า

  digitalWrite(IN1, HIGH);

  digitalWrite(IN2, LOW);

  // มอเตอร์ซ้ายเดินหน้า

  digitalWrite(IN3, LOW);

  digitalWrite(IN4, HIGH);

  analogWrite(ENA, TURN_SPEED);

  analogWrite(ENB, 0);

}

// ============================================================

// 11. ค้นหาเส้นทางขวา

// ============================================================

//

// เมื่อหลุดเส้นและเส้นล่าสุดอยู่ทางขวา

//

// หยุดล้อขวา

// ปล่อยล้อซ้ายเดินหน้า

//

// หุ่นจะค่อย ๆ หันไปทางขวา

// ===========================
void searchRight() {

  // มอเตอร์ขวาเดินหน้า

  digitalWrite(IN1, HIGH);

  digitalWrite(IN2, LOW);

  // มอเตอร์ซ้ายเดินหน้า

  digitalWrite(IN3, LOW);

  digitalWrite(IN4, HIGH);

  analogWrite(ENA, 0);

  analogWrite(ENB, TURN_SPEED);

}

// ============================================================

// 12. หยุด

// ============================================================

void stopMotor() {

  analogWrite(ENA, 0);

  analogWrite(ENB, 0);

  digitalWrite(IN1, LOW);

  digitalWrite(IN2, LOW);

  digitalWrite(IN3, LOW);

  digitalWrite(IN4, LOW);

}
